/* SPDX-License-Identifier: GPL-2.0 */

&slim_aud {
	status = "disabled";
};

&wcd934x_cdc {
	status = "disabled";
};

&pmic_analog_codec {
	status = "okay";
	qcom,cdc-micbias-cfilt-mv = <2700000>;
};
