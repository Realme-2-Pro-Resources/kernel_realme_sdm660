/* SPDX-License-Identifier: GPL-2.0 */

#include "sdm660-common-overlay.dtsi"
#include "sdm660-audio-overlay.dtsi"
#include "sdm660-coresight-overlay.dtsi"
#include "sdm660-blsp-overlay.dtsi"
#include "msm-pm660a-overlay.dtsi"
#include "msm-pm660l-overlay.dtsi"
#include "msm-pm660-overlay.dtsi"
#include "msm-audio-overlay.dtsi"
